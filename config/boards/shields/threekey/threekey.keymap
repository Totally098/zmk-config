#include <behaviors.dtsi>
#include <dt-bindings/zmk/keys.h>
#include <dt-bindings/zmk/bt.h>

/ {
    keymap {
        compatible = "zmk,keymap";
        default_layer {
            bindings = <
                &kp C_PLAY_PAUSE &kp C_VOLUME_UP &kp C_VOLUME_DOWN
            >;
        };
        bt_layer {
            bindings = <
                &bt BT_CLR &none &none
            >;
        };
    };
};
